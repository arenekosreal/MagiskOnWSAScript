## Kconfig.patch
```kconfig
diff --git a/drivers/base/superuser/Kconfig b/drivers/base/superuser/Kconfig
index 3481f5d..185618f 100644
--- a/drivers/base/superuser/Kconfig
+++ b/drivers/base/superuser/Kconfig
@@ -11,12 +11,12 @@ config ASSISTED_SUPERUSER
 
 config HIDE_ASSISTED_SUPERUSER
 	bool "hide Kernel-assisted superuser"
-    depends on ASSISTED_SUPERUSER
+	depends on ASSISTED_SUPERUSER
 	help
-	  When this option is on, only processes with uid/gid=0/2000
-      will has the permission to access /system/xbin/su. Other
-      processes will never have permission to access/stat/exec
-      su binary.
+	  When this option is on, only processes with uid/gid=0/2000 will has
+	  the permission to access /system/xbin/su. Other processes will never
+	  have permission to access/stat/exec su binary.
 
 	  Say N here unless you have a vendetta against kittens.
+
 endmenu
```
